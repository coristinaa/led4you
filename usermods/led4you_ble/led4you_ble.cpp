// AI: below section was generated by an AI
/*
 * LED4YOU usermod: Bluetooth Low Energy + "My LEDs" effect + LED4YOU Studio web page
 *
 *  Bluetooth (NimBLE-Arduino, https://github.com/h2zero/NimBLE-Arduino)
 *   - Improv Wi-Fi over BLE (spec: https://www.improv-wifi.com/ble/) for Wi-Fi provisioning
 *   - control service:
 *       CMD   (write)       WLED JSON state commands (same format as /json/state), up to 4 KB,
 *                           plus {"l4ycfg":{...}} to change LED hardware settings (same format as /json/cfg)
 *       STATE (read/notify) compact state summary (power, brightness, effect, LED count, matrix size, IP...)
 *       FILE  (write/notify) small file upload (GIF images, My LEDs table) with an ack per transfer
 *       LIST  (read/write/notify) pages "~<page><count>" + up to 480 bytes of {"d":{diagnostics},"m":LED map on,"f":text fonts,"g":[GIF files],"p":[[preset id,"name"]],"x":{LED4YOU Extras status}} (write a page number, then read it)
 *   BLE callbacks run in the NimBLE host task: they only hand data to a FreeRTOS queue.
 *   All WLED state changes and file system writes happen in loop() on the main task.
 *
 *  "My LEDs" effect: every LED gets its own colour and behaviour (fixed, blink, breathe, twinkle, rainbow)
 *   and speed. The table lives in /myleds.bin (format below) so it survives a reboot and works over Wi-Fi too.
 *
 *  LED4YOU Studio (/studio): web page with the text and My LEDs editors for use over Wi-Fi.
 */
#include "wled.h"
#include <NimBLEDevice.h>
#include "html_studio.h"
#include "js_l4ylang.h"

void l4yExtrasStatus(JsonObject o);   // l4y_extras.cpp

#ifndef LED4YOU_BLE
  #warning "led4you_ble: build with -D LED4YOU_BLE so Wi-Fi modem sleep stays enabled (required for Wi-Fi/BLE coexistence)"
#endif

// Improv BLE UUIDs
#define IMPROV_SVC   "00467768-6228-2272-4663-277478268000"
#define IMPROV_STATE "00467768-6228-2272-4663-277478268001"
#define IMPROV_ERROR "00467768-6228-2272-4663-277478268002"
#define IMPROV_RPC   "00467768-6228-2272-4663-277478268003"
#define IMPROV_RES   "00467768-6228-2272-4663-277478268004"
#define IMPROV_CAPS  "00467768-6228-2272-4663-277478268005"
// LED4YOU control service UUIDs
#define L4Y_SVC      "c0de4c45-4434-594f-55aa-000000000000"
#define L4Y_CMD      "c0de4c45-4434-594f-55aa-000000000001"
#define L4Y_STATE    "c0de4c45-4434-594f-55aa-000000000002"
#define L4Y_FILE     "c0de4c45-4434-594f-55aa-000000000003"
#define L4Y_LIST     "c0de4c45-4434-594f-55aa-000000000004"
#define L4Y_PEEK     "c0de4c45-4434-594f-55aa-000000000005"   // live preview: [cols][rows] + RGB per sampled LED
#define L4Y_PEEK_MAX 168         // LEDs per preview frame (2 + 168 x 3 bytes fits one 512-byte BLE value)
#define L4Y_LIST_PAGE 480        // bytes of the LIST JSON per page (a Bluetooth value is at most 512 bytes)

#define L4Y_JSON_MAX   2048        // largest JSON command (the app sends pixel art in chunks of 150 LEDs, ~1.4 KB)
#define L4Y_FILE_MAX   (64*1024)   // largest file accepted over Bluetooth
#define L4Y_BLE_IDLE_OFF (60UL*1000)   // with Wi-Fi up: switch Bluetooth off after this long without an app connected
#define L4Y_MYLEDS_MAX 1024        // LEDs covered by the My LEDs table

// ---------------- "My LEDs" effect ----------------
// /myleds.bin: "L4Y" + version byte (1) + LED count (uint16 LE) + 6 bytes per LED:
//   r, g, b, mode (0 fixed, 1 blink, 2 breathe, 3 twinkle, 4 rainbow), speed (0..255), phase (0..255)
static const char MYLEDS_FILE[] = "/myleds.bin";
static volatile uint16_t myLedsVersion = 1;   // bumped after every upload so the effect reloads the table
static uint8_t myLedsFxId = 255;
bool l4yBleActive = false;   // read by wled.cpp: Wi-Fi modem sleep only while Bluetooth runs
// "switch Bluetooth on" restarts the board (starting Bluetooth again in a running board was not reliable on the
// ESP32-C3): this value survives the software restart and keeps Bluetooth on for 5 minutes after it
#define L4Y_BLE_GRACE_MAGIC 0x4C34B1E5u
RTC_NOINIT_ATTR static uint32_t l4yBleGraceMagic;
// sound from the phone (audioreactive usermod, LED4YOU builds). This empty stand-in is used when that usermod
// or its LED4YOU part is not in the build (e.g. the WLED CI "usermods" build), so linking never fails.
__attribute__((weak)) void l4yAudioInject(const uint8_t*, size_t) {}
// how many GIFs can play at once (image_loader.cpp); 0 when the build has no GIF player
__attribute__((weak)) int l4yGifSlotCount() { return 0; }

// Small integer hash used to make twinkle patterns differ per LED and per cycle
static inline uint32_t l4yHash(uint32_t x) {
  x ^= x >> 16; x *= 0x7feb352dU; x ^= x >> 15; x *= 0x846ca68bU; x ^= x >> 16;
  return x;
}

// Effect function: draws the stored per-LED table. Segment speed slider scales all LED speeds.
static void mode_myleds(void) {
  // (re)load the table when the effect starts or a new table was uploaded
  if (SEGENV.call == 0 || SEGENV.aux0 != myLedsVersion) {
    SEGENV.aux0 = myLedsVersion;
    SEGENV.aux1 = 0;
    // a zone can have its own design: /mylz<zone>.bin, else the shared /myleds.bin
    char fn[16];
    snprintf_P(fn, sizeof(fn), PSTR("/mylz%u.bin"), (unsigned)strip.getCurrSegmentId());
    File f = WLED_FS.exists(fn) ? WLED_FS.open(fn, "r") : WLED_FS.open(MYLEDS_FILE, "r");
    if (f) {
      uint8_t hdr[6];
      if (f.read(hdr, 6) == 6 && hdr[0] == 'L' && hdr[1] == '4' && hdr[2] == 'Y' && hdr[3] == 1) {
        // never load more entries than this segment can show: keeps the effect data small
        unsigned n = min((unsigned)(hdr[4] | (hdr[5] << 8)), min((unsigned)SEGLEN, (unsigned)L4Y_MYLEDS_MAX));
        if (n && SEGENV.allocateData(n * 6) && f.read(SEGENV.data, n * 6) == (int)(n * 6)) SEGENV.aux1 = n;
      }
      f.close();
    }
  }
  const unsigned n = SEGENV.aux1;
  const uint8_t* tbl = SEGENV.data;
  const uint32_t now = strip.now;
  // global speed: slider 128 = recorded speed, 0 = 4x slower, 255 = 2x faster
  const uint32_t gScale = 32 + SEGMENT.speed;   // 32..287, 160 is "normal"
  for (unsigned i = 0; i < SEGLEN; i++) {
    if (i >= n) { SEGMENT.setPixelColor(i, BLACK); continue; }
    const uint8_t* r = tbl + i * 6;
    uint32_t c = RGBW32(r[0], r[1], r[2], 0);
    const uint8_t mode = r[3];
    // period between 3000 ms (speed 0) and ~200 ms (speed 255), scaled by the global slider
    uint32_t period = ((3000 - r[4] * 11) * 160) / gScale;
    if (period < 60) period = 60;
    const uint32_t t = now + (uint32_t)r[5] * period / 256;   // phase shifts each LED within its cycle
    const uint8_t pos = (t % period) * 256 / period;           // 0..255 position in the cycle
    switch (mode) {
      case 1: if (pos >= 128) c = BLACK; break;                                   // blink
      case 2: c = color_fade(c, 16 + (sin8_t(pos - 64) * 239 >> 8)); break;       // breathe
      case 3: {                                                                   // twinkle
        // soft glow; in about half of the cycles (random per LED) a quick sparkle up to full brightness
        const uint32_t cycle = t / period;
        uint8_t lvl = 70;
        if (l4yHash(i * 7919 + cycle) & 1) {
          const uint8_t tri = pos < 128 ? pos * 2 : (255 - pos) * 2;
          lvl = 70 + ((185 * tri) >> 8);
        }
        c = color_fade(c, lvl);
        break;
      }
      case 4: c = SEGMENT.color_wheel(pos + r[5]); break;                         // rainbow
      default: break;                                                             // fixed
    }
    SEGMENT.setPixelColor(i, c);
  }
}
static const char _data_FX_MYLEDS[] PROGMEM = "My LEDs@Speed;;;12;sx=128";

// ---------------- diagnostics shown in the app (Setup tab and Wi-Fi card) ----------------
static volatile uint8_t l4yWifiReason = 0;      // last reason the Wi-Fi station was disconnected (ESP-IDF wifi_err_reason_t), 0 = none
static volatile uint16_t l4yWifiFails = 0;      // how many times joining the network failed since start

// ---------------- messages from the BLE task ----------------
struct L4yBleMsg {
  uint8_t  kind;    // 1 Improv RPC, 2 JSON command, 3 file packet
  uint16_t len;
  uint8_t* data;    // heap copy, freed by the main task
};

class Led4youBle : public Usermod {
  private:
    static const char _name[];
    static const char _enabled[];
    static const char _keepOn[];

    bool enabled = true;
    bool keepOnWifi = false;  // false (default): switch Bluetooth off once Wi-Fi is connected, frees ~50 KB RAM for the LEDs
    bool running = false;
    int8_t   bleWanted = -1;      // {"l4y":{"ble":1|0}}: switch Bluetooth on / off without a restart (-1 = nothing asked)
    uint32_t bleGraceUntil = 0;   // switched on by hand: stays on this long even with Wi-Fi up and no app yet
    QueueHandle_t queue = nullptr;

    NimBLEServer*         server   = nullptr;
    NimBLECharacteristic* impState = nullptr;
    NimBLECharacteristic* impError = nullptr;
    NimBLECharacteristic* impRes   = nullptr;
    NimBLECharacteristic* ctlState = nullptr;
    NimBLECharacteristic* ctlFile  = nullptr;
    NimBLECharacteristic* ctlList  = nullptr;
    NimBLECharacteristic* ctlPeek  = nullptr;
    uint32_t lastPeek = 0;

    // Improv
    enum : uint8_t { ST_AUTHORIZED = 0x02, ST_PROVISIONING = 0x03, ST_PROVISIONED = 0x04 };
    uint8_t  improvState = ST_AUTHORIZED;
    uint32_t provStart = 0;
    static const uint8_t CAPS = 0x02; // bit1: device info

    // reassembly buffers (only touched from the BLE task)
    uint8_t rpcBuf[160]; size_t rpcLen = 0;
    char*   cmdBuf = nullptr; size_t cmdLen = 0;

    // file transfer (main task)
    File     upFile;
    char     upName[33] = "";
    uint32_t upSize = 0, upDone = 0;
    uint8_t  upAction = 0;   // 0 store only, 1 play GIF, 2 load My LEDs

    String   lastStateJson;
    uint32_t lastStateCheck = 0;
    bool     listDirty = true;
    bool     hadClient = false;
    String   gifJson = "[]", presetJson = "[]", lastList;
    uint16_t psMask = 0;                    // bit i set: preset i (1..10) exists, shown in the app's preset grid
    unsigned long psMaskTime = 0xFFFFFFFF;  // presetsModifiedTime the mask was built for
    uint32_t lastListBuild = 0;
    uint32_t idleSince = 0;   // last time an app was connected (or Bluetooth started)
    bool     rebootWhenSaved = false;   // fallback: restart after WLED's loop has written cfg.json
    bool     rebootAfterSave = false;   // LED settings from the app were written to cfg.json: restart to apply them

    // ---------- BLE task side ----------
    void enqueue(uint8_t kind, const uint8_t* d, size_t len) {
      if (!queue || len == 0) return;
      uint8_t* p = (uint8_t*)malloc(len);
      if (!p) return;
      memcpy(p, d, len);
      L4yBleMsg m = { kind, (uint16_t)len, p };
      // wait up to 2 s: this throttles a fast sender instead of dropping file chunks
      if (xQueueSend(queue, &m, pdMS_TO_TICKS(2000)) != pdTRUE) free(p);
    }

    // Improv RPC may arrive split over several writes: [cmd][len][data...][checksum]
    void onRpcWrite(const uint8_t* d, size_t len) {
      if (rpcLen + len > sizeof(rpcBuf)) rpcLen = 0;
      memcpy(rpcBuf + rpcLen, d, len); rpcLen += len;
      if (rpcLen >= 2 && rpcLen >= (size_t)rpcBuf[1] + 3) {
        enqueue(1, rpcBuf, rpcBuf[1] + 3);
        rpcLen = 0;
      }
    }

    // JSON command may be split too: collect until braces balance
    void onCmdWrite(const uint8_t* d, size_t len) {
      if (!cmdBuf) return;
      if (cmdLen + len > L4Y_JSON_MAX) cmdLen = 0;
      memcpy(cmdBuf + cmdLen, d, len); cmdLen += len;
      int depth = 0; bool started = false, inStr = false;
      for (size_t i = 0; i < cmdLen; i++) {
        char ch = cmdBuf[i];
        if (inStr) { if (ch == '\\') i++; else if (ch == '"') inStr = false; continue; }
        if (ch == '"') inStr = true;
        else if (ch == '{') { depth++; started = true; }
        else if (ch == '}') depth--;
      }
      if (started && depth == 0) { enqueue(2, (const uint8_t*)cmdBuf, cmdLen); cmdLen = 0; }
    }

    class CharCB : public NimBLECharacteristicCallbacks {
      public:
        Led4youBle* um; uint8_t which;
        CharCB(Led4youBle* u, uint8_t w) : um(u), which(w) {}
        void onWrite(NimBLECharacteristic* c) override {
          NimBLEAttValue v = c->getValue();
          if (which == 1)      um->onRpcWrite(v.data(), v.length());
          else if (which == 2) {
            // 0xA5 + 44 bytes: sound from the phone's microphone, straight to the sound effects (no JSON, no queue)
            if (v.length() == 45 && v.data()[0] == 0xA5) { l4yAudioInject(v.data() + 1, 44); }
            else um->onCmdWrite(v.data(), v.length());
          }
          else if (which == 4) { if (v.length()) um->selectListPage(v.data()[0]); }   // app asks for another page of LIST
          else                 um->enqueue(3, v.data(), v.length()); // file packets are self-contained
        }
    };

    // ---------- main task side ----------
    void setImprovState(uint8_t s) {
      improvState = s;
      if (impState) { impState->setValue(&s, 1); impState->notify(); }
      updateAdvertising();
    }
    void setImprovError(uint8_t e) {
      if (impError) { impError->setValue(&e, 1); impError->notify(); }
    }
    // build RPC result: [cmd][len][l1][s1]...[checksum]
    void sendImprovResult(uint8_t cmd, const char* const* strs, uint8_t n) {
      uint8_t buf[200]; size_t p = 2;
      for (uint8_t i = 0; i < n; i++) {
        size_t l = strlen(strs[i]);
        if (p + 1 + l + 1 > sizeof(buf)) break;
        buf[p++] = l; memcpy(buf + p, strs[i], l); p += l;
      }
      buf[0] = cmd; buf[1] = p - 2;
      uint8_t sum = 0; for (size_t i = 0; i < p; i++) sum += buf[i];
      buf[p++] = sum;
      if (impRes) { impRes->setValue(buf, p); impRes->notify(); }
    }

    void handleImprov(const uint8_t* d, size_t len) {
      uint8_t sum = 0; for (size_t i = 0; i + 1 < len; i++) sum += d[i];
      if (len < 3 || sum != d[len - 1]) { setImprovError(0x01); return; } // invalid packet
      setImprovError(0x00);
      uint8_t cmd = d[0]; uint8_t dlen = d[1]; const uint8_t* data = d + 2;
      switch (cmd) {
        case 0x01: { // Wi-Fi settings: [ssidLen][ssid][passLen][pass]
          uint8_t sl = data[0];
          if (sl == 0 || sl > 32 || (size_t)sl + 1 > dlen) { setImprovError(0x01); return; }
          memset(multiWiFi[0].clientSSID, 0, sizeof(multiWiFi[0].clientSSID));
          memcpy(multiWiFi[0].clientSSID, data + 1, sl);
          memset(multiWiFi[0].clientPass, 0, sizeof(multiWiFi[0].clientPass));
          if (dlen > sl + 1) {
            uint8_t pl = data[sl + 1];
            memcpy(multiWiFi[0].clientPass, data + sl + 2, min((size_t)pl, sizeof(multiWiFi[0].clientPass) - 1));
          }
          forceReconnect = true;
          configNeedsWrite = true;   // saved by WLED's loop (retried there if the JSON buffer is busy)
          provStart = millis();
          setImprovState(ST_PROVISIONING);
          break;
        }
        case 0x03: { // device info
          extern const int l4yFwVersion;
          char v[16]; snprintf_P(v, sizeof(v), PSTR("v%d"), l4yFwVersion);
          String chip = ESP.getChipModel(); chip.toUpperCase();
          const char* s[4] = { WLED_BRAND, v, chip.c_str(), serverDescription };
          sendImprovResult(0x03, s, 4);
          break;
        }
        default: setImprovError(0x02); // unknown command
      }
    }

    // apply a JSON command: state change, or LED hardware settings ({"l4ycfg":{...}})
    void handleJsonCmd(const uint8_t* d, size_t len) {
      if (!requestJSONBufferLock(JSON_LOCK_REMOTE)) return;
      DeserializationError err = deserializeJson(*pDoc, (const char*)d, len);
      if (!err) {
        JsonObject root = pDoc->as<JsonObject>();
        JsonObject cfgIn = root[F("l4ycfg")];
        if (!cfgIn.isNull()) {
          // the command is copied out of the shared JSON buffer: saveLedCfg() reads cfg.json into that buffer
          DynamicJsonDocument cc(len * 2 + 1024);
          cc.set(cfgIn);
          JsonObject cfg = cc.as<JsonObject>();
          // LED hardware (pin, type, count, matrix): written straight into cfg.json, then a restart applies it.
          // Changing outputs and matrix mode while the LEDs run (and saving the running state afterwards) could
          // lose the change, e.g. matrix -> strip right after strip -> matrix.
          if (saveLedCfg(cfg)) { rebootAfterSave = true; applyL4yDmx(cfg[F("l4ydmx")]); }   // running copy too, in case it is written again before the restart
          else {   // no cfg.json yet (brand-new board): apply through WLED and restart once it has saved
            if (cfg[F("l4ymx")].is<bool>() && !cfg[F("l4ymx")].as<bool>()) { strip.isMatrix = false; strip.panel.clear(); }
            deserializeConfig(cfg, false);
            applyL4yDmx(cfg[F("l4ydmx")]);   // not a WLED setting: deserializeConfig() leaves it out
            configNeedsWrite = true;
            rebootWhenSaved = true;
          }
        } else {
          deserializeState(root, CALL_MODE_DIRECT_CHANGE);
        }
      }
      releaseJSONBufferLock();
    }

    // merge {"hw":{"led":{...}}} (and "l4ymx": false = no matrix), {"dmx":{...}} (WLED DMX output settings) and
    // {"l4ydmx":{"on":..,"pin":..}} (LED4YOU DMX output switch and pin) into /cfg.json; true when written
    // LED4YOU DMX output switch, pin and number of lights straight into the running settings (saved with the config)
    static void applyL4yDmx(JsonObject nl4d) {
#ifdef WLED_ENABLE_DMX
      extern bool l4yDmxOutOn; extern int8_t l4yDmxOutPin; extern uint16_t l4yDmxOutFixtures;
      if (nl4d.isNull()) return;
      if (nl4d[F("on")].is<bool>()) l4yDmxOutOn = nl4d[F("on")].as<bool>();
      if (nl4d[F("pin")].is<int>()) l4yDmxOutPin = nl4d[F("pin")].as<int>();
      if (nl4d[F("n")].is<int>()) l4yDmxOutFixtures = nl4d[F("n")].as<int>();
#endif
    }

    bool saveLedCfg(JsonObject cmd) {
      JsonObject nled = cmd[F("hw")][F("led")];
      JsonObject ndmx = cmd[F("dmx")];
      JsonObject nl4d = cmd[F("l4ydmx")];
      JsonObject nlight = cmd[F("light")];   // only "aseg": one zone per LED output after a restart
      if (nled.isNull() && ndmx.isNull() && nl4d.isNull() && nlight.isNull()) return false;
      const bool noMatrix = cmd[F("l4ymx")].is<bool>() && !cmd[F("l4ymx")].as<bool>();
      // cfg.json is read into WLED's own JSON buffer (32 KB, the caller holds its lock): a separate 12 KB document
      // ran out of room once the config had grown, and then nothing was saved (e.g. DMX could not be switched on again)
      JsonDocument& d = *pDoc;
      d.clear();
      {
        File f = WLED_FS.open(F("/cfg.json"), "r");
        if (!f) return false;
        DeserializationError e = deserializeJson(d, f);
        f.close();
        if (e) return false;
      }
      if (!nled.isNull()) {
        JsonObject led = d[F("hw")][F("led")];
        if (led.isNull()) led = d.createNestedObject(F("hw")).createNestedObject(F("led"));
        for (JsonPair kv : nled) led[String(kv.key().c_str())] = kv.value();   // String key: copied into this document   // ins, total, maxpwr, matrix... replace the old ones
        if (noMatrix) led.remove(F("matrix"));
      }
      if (!nlight.isNull() && nlight[F("aseg")].is<bool>()) {
        JsonObject li = d[F("light")];
        if (li.isNull()) li = d.createNestedObject(F("light"));
        li[F("aseg")] = nlight[F("aseg")].as<bool>();
      }
      if (!ndmx.isNull()) {   // chan, gap, start, start-led, fixmap
        JsonObject dm = d[F("dmx")];
        if (dm.isNull()) dm = d.createNestedObject(F("dmx"));
        for (JsonPair kv : ndmx) dm[String(kv.key().c_str())] = kv.value();
      }
      if (!nl4d.isNull()) {
        JsonObject um = d[F("um")];
        if (um.isNull()) um = d.createNestedObject(F("um"));
        JsonObject ex = um[F("LED4YOU Extras")];
        if (ex.isNull()) ex = um.createNestedObject(F("LED4YOU Extras"));
        if (nl4d[F("on")].is<bool>()) ex[F("DMX output")] = nl4d[F("on")].as<bool>();
        if (nl4d[F("pin")].is<int>()) ex[F("DMX output GPIO")] = nl4d[F("pin")].as<int>();
        if (nl4d[F("n")].is<int>()) ex[F("DMX fixtures")] = nl4d[F("n")].as<int>();
      }
      if (d.overflowed()) return false;
      backupConfig();
      File f = WLED_FS.open(F("/cfg.json"), "w");
      if (!f) return false;
      const size_t n = serializeJson(d, f);
      f.close();
      if (!n) { restoreConfig(); return false; }
      configNeedsWrite = false;   // the running (old) settings must not overwrite the file before the restart
      return true;
    }

    static bool validName(const char* n) {
      size_t l = strlen(n);
      if (l < 5 || l > 31) return false;
      for (size_t i = 0; i < l; i++) {
        char c = n[i];
        if (!(isalnum((unsigned char)c) || c == '-' || c == '_' || c == '.')) return false;
      }
      // only images, the My LEDs table, the LED map and the LED4YOU text fonts (l4yf0..4.wbf) may be written over Bluetooth (never config files)
      if (strcmp_P(n, PSTR("ledmap.json")) == 0) return true;   // LED positions from the camera scan (used after a restart)
      if (l == 9 && strncmp_P(n, PSTR("l4yf"), 4) == 0 && n[4] >= '0' && n[4] <= '4' && strcmp_P(n + 5, PSTR(".wbf")) == 0) return true;
      // My LEDs design of one zone: mylz0.bin .. mylz15.bin
      if (strncmp_P(n, PSTR("mylz"), 4) == 0 && strcmp_P(n + l - 4, PSTR(".bin")) == 0 && l >= 9 && l <= 10 && isdigit((unsigned char)n[4]) && (l == 9 || isdigit((unsigned char)n[5]))) return atoi(n + 4) < 16;
      return strcmp_P(n, PSTR("myleds.bin")) == 0 || strcasecmp(n + l - 4, ".gif") == 0;
    }

    void fileAck(uint8_t type, uint8_t ok) {
      uint8_t a[6] = { type, ok, (uint8_t)upDone, (uint8_t)(upDone >> 8), (uint8_t)(upDone >> 16), (uint8_t)(upDone >> 24) };
      if (ctlFile) { ctlFile->setValue(a, sizeof(a)); ctlFile->notify(); }
    }

    // file packets: 0x01 begin [size u32][action u8][nameLen u8][name]
    //               0x02 data  [offset u32][bytes]
    //               0x03 end
    //               0x04 delete [nameLen u8][name]
    void handleFile(const uint8_t* d, size_t len) {
      if (len < 1) return;
      switch (d[0]) {
        case 0x01: {
          if (upFile) upFile.close();
          upDone = 0;
          if (len < 7) { fileAck(1, 0); return; }
          upSize = d[1] | (d[2] << 8) | (d[3] << 16) | ((uint32_t)d[4] << 24);
          upAction = d[5];
          uint8_t nl = d[6];
          if (nl > 31 || len < 7u + nl || upSize == 0 || upSize > L4Y_FILE_MAX) { fileAck(1, 0); return; }
          memcpy(upName, d + 7, nl); upName[nl] = 0;
          if (!validName(upName)) { fileAck(1, 0); return; }
          updateFSInfo();
          if (fsBytesTotal - fsBytesUsed < upSize + 8192) { fileAck(1, 2); return; } // 2 = not enough space
          upFile = WLED_FS.open("/l4y_upload.tmp", "w");
          fileAck(1, upFile ? 1 : 0);
          break;
        }
        case 0x02: {
          if (!upFile || len < 5) { fileAck(2, 0); return; }
          uint32_t off = d[1] | (d[2] << 8) | (d[3] << 16) | ((uint32_t)d[4] << 24);
          if (off != upDone || upDone + (len - 5) > upSize) { fileAck(2, 0); upFile.close(); return; }
          upDone += upFile.write(d + 5, len - 5);
          break;   // no ack per chunk: the GATT write itself is acknowledged
        }
        case 0x03: {
          if (!upFile) { fileAck(3, 0); return; }
          upFile.close();
          if (upDone != upSize) { WLED_FS.remove("/l4y_upload.tmp"); fileAck(3, 0); return; }
          String path = String('/') + upName;
          WLED_FS.remove(path);
          bool ok = WLED_FS.rename("/l4y_upload.tmp", path);
          updateFSInfo();
          if (ok) applyUploadAction();
          listDirty = true;
          fileAck(3, ok ? 1 : 0);
          break;
        }
        case 0x04: {
          if (len < 2 || len < 2u + d[1] || d[1] > 31) { fileAck(4, 0); return; }
          char n[33]; memcpy(n, d + 2, d[1]); n[d[1]] = 0;
          bool ok = validName(n) && WLED_FS.remove(String('/') + n);
          updateFSInfo(); listDirty = true;
          fileAck(4, ok ? 1 : 0);
          break;
        }
      }
    }

    // after an upload: start the GIF, or reload and start My LEDs
    void applyUploadAction() {
      if (upAction == 0) return;
      if (!requestJSONBufferLock(JSON_LOCK_REMOTE)) return;
      pDoc->clear();
      JsonObject root = pDoc->to<JsonObject>();
      root["on"] = true;
      JsonObject seg = root.createNestedObject("seg");
      if (upAction == 1) { seg["fx"] = FX_MODE_IMAGE; seg["n"] = upName; seg["sx"] = 128; seg["ix"] = 0; seg[F("frz")] = false; } // GIF timing as made, Blur 0
      else { myLedsVersion++; seg["fx"] = myLedsFxId; seg[F("frz")] = false; }
      deserializeState(root, CALL_MODE_DIRECT_CHANGE);
      releaseJSONBufferLock();
    }

    // JSON array of GIF files for the LIST characteristic (up to ~1800 bytes, sent in pages)
    // live preview for the app: a down-sampled copy of what the LEDs show, ~6 times a second, only while the app listens
    void sendPeek() {
      if (!ctlPeek || millis() - lastPeek < 160 || !ctlPeek->getSubscribedCount()) return;
      lastPeek = millis();
      uint8_t buf[2 + 3 * L4Y_PEEK_MAX];
      unsigned cols, rows, step = 1;
      #ifndef WLED_DISABLE_2D
      const bool mx = strip.isMatrix && Segment::maxHeight > 1;
      #else
      const bool mx = false;
      #endif
      if (mx) {
        cols = Segment::maxWidth; rows = Segment::maxHeight;
        while ((cols / step) * (rows / step) > L4Y_PEEK_MAX) step++;
        cols /= step; rows /= step;
      } else {
        const unsigned n = strip.getLengthTotal();
        cols = n < L4Y_PEEK_MAX ? n : L4Y_PEEK_MAX; rows = 1;
      }
      if (!cols || !rows || cols > 255 || rows > 255) return;
      buf[0] = cols; buf[1] = rows;
      size_t p = 2;
      for (unsigned y = 0; y < rows; y++) for (unsigned x = 0; x < cols; x++) {
        if (mx && step > 1) {
          // a big matrix is shown smaller: average each step x step block, so pictures and text stay readable
          // (taking one LED per block made thin lines and text flicker in and out)
          unsigned r = 0, g = 0, b = 0;
          for (unsigned dy = 0; dy < step; dy++) for (unsigned dx = 0; dx < step; dx++) {
            const uint32_t c = strip.getPixelColorXY(x * step + dx, y * step + dy);
            r += R(c); g += G(c); b += B(c);
          }
          const unsigned n = step * step;
          // a bit brighter than the plain average, so a few lit LEDs in a block still show
          r = min(255u, r * 3 / (n * 2)); g = min(255u, g * 3 / (n * 2)); b = min(255u, b * 3 / (n * 2));
          buf[p++] = r; buf[p++] = g; buf[p++] = b;
          continue;
        }
        uint32_t c;
        if (mx) c = strip.getPixelColorXY(x * step, y * step);
        else c = strip.getPixelColor((x * strip.getLengthTotal()) / cols);
        buf[p++] = R(c); buf[p++] = G(c); buf[p++] = B(c);
      }
      ctlPeek->setValue(buf, p);
      ctlPeek->notify();
    }

    // pages of the LIST value (see updateList), shared with the Bluetooth task
    std::vector<String> listPages;
    SemaphoreHandle_t listMux = nullptr;
  public:
    void selectListPage(uint8_t p) {   // runs in the Bluetooth task
      if (!listMux || xSemaphoreTake(listMux, pdMS_TO_TICKS(50)) != pdTRUE) return;
      if (p < listPages.size() && ctlList) ctlList->setValue((const uint8_t*)listPages[p].c_str(), listPages[p].length());
      xSemaphoreGive(listMux);
    }
  private:
    // GIF names, cached until a file is added or removed
    uint8_t fontCount = 0;   // LED4YOU text fonts with emoji on the lights
    bool    mapFile = false; // ledmap.json from the camera scan is on the lights
    void updateGifs() {
      listDirty = false;
      gifJson = "[";
      fontCount = 0; mapFile = false;
      File root = WLED_FS.open("/");
      File f = root.openNextFile();
      while (f) {
        String n = f.name();
        if (n.startsWith("/")) n = n.substring(1);
        if (n.startsWith("l4yf") && n.endsWith(".wbf")) fontCount++;
        if (n == "ledmap.json") mapFile = true;
        if ((n.endsWith(".gif") || n.endsWith(".GIF")) && gifJson.length() + n.length() + 4 <= 1800) {
          if (gifJson.length() > 1) gifJson += ',';
          gifJson += '"'; gifJson += n; gifJson += '"';
        }
        f = root.openNextFile();
      }
      gifJson += ']';
    }

    // LIST characteristic: {"g":[gif names],"p":[[id,"name"],...],"x":{extras status}}
    // longer than one BLE packet: the app reads it again after each notification
    void updateList() {
      if (!ctlList) return;
      if (listDirty) updateGifs();
      updatePresetMask();
      String x;
      {
        StaticJsonDocument<1024> d;
        l4yExtrasStatus(d.to<JsonObject>());
        serializeJson(d, x);
      }
      String out;
      out.reserve(gifJson.length() + presetJson.length() + x.length() + 600);
      // diagnostics: Wi-Fi status and whether LED settings are still waiting to be saved
      String dg;
      {
        StaticJsonDocument<320> d;
        d[F("ws")] = (int)WiFi.status(); d[F("wr")] = l4yWifiReason; d[F("wf")] = l4yWifiFails;
        d[F("wm")] = (int)WiFi.getMode(); d[F("ap")] = apActive; d[F("ss")] = multiWiFi.size() ? multiWiFi[0].clientSSID : "";
        d[F("ch")] = WiFi.channel(); d[F("tx")] = (int)WiFi.getTxPower();
        d[F("cw")] = configNeedsWrite; d[F("ib")] = doInitBusses; d[F("rs")] = rebootAfterSave; d[F("jl")] = jsonBufferLock;
        Bus* b0 = BusManager::getBus(0); uint8_t pp[5] = {255,255,255,255,255}; if (b0) b0->getPins(pp);
        d[F("bp")] = pp[0] == 255 ? -1 : pp[0]; d[F("nb")] = BusManager::getNumBusses(); d[F("rr")] = (int)esp_reset_reason(); d[F("hf")] = (ESP.getFreeHeap() >> 12) << 2; d[F("hb")] = (heap_caps_get_largest_free_block(MALLOC_CAP_8BIT) >> 12) << 2;   // KB, in 4 KB steps
        serializeJson(d, dg);
      }
      // zones (segments): [id, start, stop, startY, stopY, on, reverse, mirror] for the app's zone editor
      String zj = F("[");
      for (unsigned i = 0; i < strip.getSegmentsNum() && i < 16; i++) {
        Segment& sg = strip.getSegment(i);
        if (sg.stop <= sg.start) continue;   // listed even without a pixel buffer (low memory), so the app never loses it
        if (zj.length() > 1) zj += ',';
        char zb[48];
        snprintf_P(zb, sizeof(zb), PSTR("[%u,%u,%u,%u,%u,%u,%u,%u]"), i, sg.start, sg.stop, sg.startY, sg.stopY, sg.on ? 1 : 0, sg.reverse ? 1 : 0, sg.mirror ? 1 : 0);
        zj += zb;
      }
      zj += ']';
      // matrix panels: [x, y, width, height, options] in wiring order, so the app can draw and edit them
      String pj = F("[");
#ifndef WLED_DISABLE_2D
      if (strip.isMatrix) for (size_t i = 0; i < strip.panel.size() && i < WLED_MAX_PANELS; i++) {
        const auto& pn = strip.panel[i];
        if (pj.length() > 1) pj += ',';
        char pb[40];
        snprintf_P(pb, sizeof(pb), PSTR("[%u,%u,%u,%u,%u]"), pn.xOffset, pn.yOffset, pn.width, pn.height, pn.options);
        pj += pb;
      }
#endif
      pj += ']';
      // LED outputs: [pin, LED count, chip type, colour order, first LED] for each digital output, and how many the board can drive
      String oj = F("[");
      for (unsigned i = 0; i < BusManager::getNumBusses() && i < 8; i++) {
        Bus* bb = BusManager::getBus(i);
        if (!bb || !bb->isDigital()) continue;
        uint8_t bp[5] = {255,255,255,255,255}; bb->getPins(bp);
        if (oj.length() > 1) oj += ',';
        char ob[48];
        snprintf_P(ob, sizeof(ob), PSTR("[%d,%u,%u,%u,%u]"), bp[0] == 255 ? -1 : bp[0], bb->getLength(), bb->getType() & 0x7F, bb->getColorOrder() & 0x0F, bb->getStart());
        oj += ob;
      }
      oj += ']';
      // DMX output settings: [on, pin, channels per fixture, gap, start address, first LED, fixtures, [channel map], running]
      String dx;
#ifdef WLED_ENABLE_DMX
      {
        extern bool l4yDmxOutOn, l4yDmxOutStarted; extern int8_t l4yDmxOutPin; extern uint16_t l4yDmxOutFixtures;
        char db[56];
        snprintf_P(db, sizeof(db), PSTR("[%u,%d,%u,%u,%u,%u,%u,["), l4yDmxOutOn ? 1 : 0, (int)l4yDmxOutPin, DMXChannels, DMXGap, DMXStart, DMXStartLED, l4yDmxOutFixtures);
        dx = db;
        for (unsigned i = 0; i < 15; i++) { if (i) dx += ','; dx += DMXFixtureMap[i]; }
        dx += F("],"); dx += l4yDmxOutStarted ? '1' : '0'; dx += ']';   // [8]: the DMX output really runs
      }
#else
      dx = F("null");
#endif
      out = F("{\"d\":"); out += dg; out += F(",\"z\":"); out += zj; out += F(",\"pn\":"); out += pj; out += F(",\"dx\":"); out += dx; out += F(",\"o\":"); out += oj; out += F(",\"mo\":"); out += (WLED_MAX_RMT_CHANNELS > 4 ? 4 : WLED_MAX_RMT_CHANNELS); out += F(",\"m\":"); out += mapFile ? 1 : 0; out += F(",\"f\":"); out += fontCount; out += F(",\"g\":"); out += gifJson; out += F(",\"p\":"); out += presetJson; out += F(",\"x\":"); out += x; out += '}';
      if (out == lastList) return;
      lastList = out;
      // a Bluetooth value holds at most 512 bytes: the list is cut into pages "~" + page + count + up to 480 bytes,
      // the app reads page 0, then writes the page number it wants next and reads again
      if (listMux && xSemaphoreTake(listMux, pdMS_TO_TICKS(100)) == pdTRUE) {
        listPages.clear();
        const unsigned n = (out.length() + L4Y_LIST_PAGE - 1) / L4Y_LIST_PAGE;
        for (unsigned i = 0; i < n && i < 9; i++) {
          String pg = String('~') + char('0' + i) + char('0' + min(n, 9u)) + out.substring(i * L4Y_LIST_PAGE, (i + 1) * L4Y_LIST_PAGE);
          listPages.push_back(pg);
        }
        if (listPages.size()) ctlList->setValue((const uint8_t*)listPages[0].c_str(), listPages[0].length());
        xSemaphoreGive(listMux);
      }
      if (server && server->getConnectedCount()) ctlList->notify();
    }

    // compact state for the State characteristic
    // rebuild the "which presets 1..10 exist" mask, only after presets.json changed (saving is asynchronous)
    void updatePresetMask() {
      if (presetsModifiedTime == psMaskTime) return;
      uint16_t m = 0;
      String n, names = "[";
      // presets 1-10 (the app's grid) and 241-248 (house scenes)
      static const uint8_t ids[] = { 1, 2, 3, 4, 5, 6, 7, 8, 9, 10, 241, 242, 243, 244, 245, 246, 247, 248 };
      for (uint8_t i : ids) {
        if (getPresetName(i, n)) {
          if (i <= 10) m |= (1 << i);
          n.replace("\\", ""); n.replace("\"", "'");   // keep the hand-built JSON valid
          if (names.length() > 1) names += ',';
          names += '['; names += i; names += F(",\""); names += n; names += F("\"]");
        }
        else if (jsonBufferLock) return;   // JSON buffer busy (could not check): try again on the next round
      }
      psMask = m;
      presetJson = names + ']';
      psMaskTime = presetsModifiedTime;
    }

    // active segments (zones) as a bit mask, for the app's "send to" choice
    static uint32_t zoneMask() {
      uint32_t m = 0;
      for (unsigned i = 0; i < strip.getSegmentsNum() && i < 32; i++) if (strip.getSegment(i).stop > strip.getSegment(i).start) m |= 1UL << i;
      return m;
    }
    String buildState() {
      Segment& s = strip.getMainSegment();
      String ip = WLED_CONNECTED ? Network.localIP().toString() : String();
      unsigned mw = 0, mh = 0;
      #ifndef WLED_DISABLE_2D
      if (strip.isMatrix) { mw = Segment::maxWidth; mh = Segment::maxHeight; }
      #endif
      // first LED output: data pin, LED count, chip type, colour order
      int pin = -1, blen = 0, btype = 0, bco = 0;
      Bus* b = BusManager::getBus(0);
      if (b) { uint8_t p[5] = {255,255,255,255,255}; b->getPins(p); pin = p[0] == 255 ? -1 : p[0]; blen = b->getLength(); btype = b->getType() & 0x7F; bco = b->getColorOrder() & 0x0F; }
      // second LED output (if any)
      int pin2 = -1, blen2 = 0;
      Bus* b2 = BusManager::getBus(1);
      if (b2 && b2->isDigital()) { uint8_t p[5] = {255,255,255,255,255}; b2->getPins(p); pin2 = p[0] == 255 ? -1 : p[0]; blen2 = b2->getLength(); }
      char buf[480];
      snprintf_P(buf, sizeof(buf),
        PSTR("{\"on\":%s,\"bri\":%u,\"fx\":%u,\"pal\":%u,\"sx\":%u,\"ix\":%u,\"c1\":%u,\"c2\":%u,\"c3\":%u,\"ps\":%d,\"col\":[%u,%u,%u],"
             "\"ip\":\"%s\",\"leds\":%u,\"mw\":%u,\"mh\":%u,\"mfx\":%u,\"fsf\":%u,"
             "\"hw\":{\"pin\":%d,\"len\":%d,\"type\":%d,\"co\":%d,\"ma\":%u,\"p2\":%d,\"l2\":%d},\"psl\":%u,\"gs\":%d,\"nz\":%u,\"zs\":%u}"),
        bri ? "true" : "false", bri ? bri : briLast, s.mode, s.palette, s.speed, s.intensity, s.custom1, s.custom2, s.custom3, (int)currentPreset,
        R(s.colors[0]), G(s.colors[0]), B(s.colors[0]),
        ip.c_str(), strip.getLengthTotal(), mw, mh, myLedsFxId, (unsigned)((fsBytesTotal - fsBytesUsed) / 1024),
        pin, blen, btype, bco, BusManager::ablMilliampsMax(), pin2, blen2, (unsigned)psMask, l4yGifSlotCount(), (unsigned)strip.getActiveSegmentsNum(), (unsigned)zoneMask());
      return String(buf);
    }

    void updateAdvertising() {
      if (!running) return;
      NimBLEAdvertising* adv = NimBLEDevice::getAdvertising();
      NimBLEAdvertisementData ad;
      ad.setFlags(BLE_HS_ADV_F_DISC_GEN | BLE_HS_ADV_F_BREDR_UNSUP);
      ad.setCompleteServices(NimBLEUUID(IMPROV_SVC));
      uint8_t sd[6] = { improvState, CAPS, 0, 0, 0, 0 };
      ad.setServiceData(NimBLEUUID((uint16_t)0x4677), std::string((char*)sd, sizeof(sd)));
      adv->setAdvertisementData(ad);
      if (adv->isAdvertising()) { adv->stop(); adv->start(); }
    }

    void startBle() {
      String mac = WiFi.macAddress(); mac.replace(":", "");
      String name = String(F(WLED_BRAND "-")) + mac.substring(8);
      NimBLEDevice::init(name.c_str());
      NimBLEDevice::setMTU(517);   // large MTU: fewer packets for pixel art and GIF uploads
      server = NimBLEDevice::createServer();
      server->advertiseOnDisconnect(true);

      NimBLEService* imp = server->createService(IMPROV_SVC);
      impState = imp->createCharacteristic(IMPROV_STATE, NIMBLE_PROPERTY::READ | NIMBLE_PROPERTY::NOTIFY);
      impError = imp->createCharacteristic(IMPROV_ERROR, NIMBLE_PROPERTY::READ | NIMBLE_PROPERTY::NOTIFY);
      NimBLECharacteristic* rpc = imp->createCharacteristic(IMPROV_RPC, NIMBLE_PROPERTY::WRITE);
      impRes   = imp->createCharacteristic(IMPROV_RES, NIMBLE_PROPERTY::READ | NIMBLE_PROPERTY::NOTIFY);
      NimBLECharacteristic* caps = imp->createCharacteristic(IMPROV_CAPS, NIMBLE_PROPERTY::READ);
      rpc->setCallbacks(new CharCB(this, 1));
      improvState = WLED_CONNECTED ? ST_PROVISIONED : ST_AUTHORIZED;
      impState->setValue(&improvState, 1);
      uint8_t z = 0; impError->setValue(&z, 1);
      uint8_t c = CAPS; caps->setValue(&c, 1);
      imp->start();

      NimBLEService* ctl = server->createService(L4Y_SVC);
      NimBLECharacteristic* cmd = ctl->createCharacteristic(L4Y_CMD, NIMBLE_PROPERTY::WRITE | NIMBLE_PROPERTY::WRITE_NR);
      ctlState = ctl->createCharacteristic(L4Y_STATE, NIMBLE_PROPERTY::READ | NIMBLE_PROPERTY::NOTIFY);
      ctlFile  = ctl->createCharacteristic(L4Y_FILE, NIMBLE_PROPERTY::WRITE | NIMBLE_PROPERTY::NOTIFY);
      ctlList  = ctl->createCharacteristic(L4Y_LIST, NIMBLE_PROPERTY::READ | NIMBLE_PROPERTY::WRITE | NIMBLE_PROPERTY::NOTIFY);
      ctlPeek  = ctl->createCharacteristic(L4Y_PEEK, NIMBLE_PROPERTY::READ | NIMBLE_PROPERTY::NOTIFY);
      cmd->setCallbacks(new CharCB(this, 2));
      ctlList->setCallbacks(new CharCB(this, 4));
      if (!listMux) listMux = xSemaphoreCreateMutex();
      ctlFile->setCallbacks(new CharCB(this, 3));
      ctl->start();

      NimBLEAdvertising* adv = NimBLEDevice::getAdvertising();
      NimBLEAdvertisementData sr; sr.setName(name.c_str());
      adv->setScanResponseData(sr);
      running = true;
      l4yBleActive = true;
      if (WLED_CONNECTED) WiFi.setSleep(true);   // required while Bluetooth runs
      idleSince = millis();
      updateAdvertising();
      adv->start();
      DEBUG_PRINTF_P(PSTR("LED4YOU BLE started as %s\n"), name.c_str());
    }

  public:
    void setup() override {
      // remember why joining the Wi-Fi failed, so the app can say it (wrong password, network not found...)
      WiFi.onEvent([](WiFiEvent_t e, WiFiEventInfo_t info) {
        if (e == ARDUINO_EVENT_WIFI_STA_DISCONNECTED) { l4yWifiReason = info.wifi_sta_disconnected.reason; l4yWifiFails++; }
        else if (e == ARDUINO_EVENT_WIFI_STA_GOT_IP) l4yWifiReason = 0;
      });
      // My LEDs effect and the Studio page work with or without Bluetooth
      myLedsFxId = strip.addEffect(255, &mode_myleds, _data_FX_MYLEDS);
      ::server.on(F("/studio"), HTTP_GET, [](AsyncWebServerRequest* request) {
        AsyncWebServerResponse* r = request->beginResponse_P(200, F("text/html"), PAGE_studio, PAGE_studio_length);
        r->addHeader(F("Content-Encoding"), F("gzip"));
        request->send(r);
      });
      // language loader used by the board's own pages (translations come from the LED4YOU site)
      ::server.on(F("/l4ylang.js"), HTTP_GET, [](AsyncWebServerRequest* request) {
        AsyncWebServerResponse* r = request->beginResponse_P(200, F("application/javascript"), JS_l4ylang, JS_l4ylang_length);
        r->addHeader(F("Content-Encoding"), F("gzip"));
        r->addHeader(F("Cache-Control"), F("max-age=3600"));
        request->send(r);
      });

      if (!enabled) return;
      cmdBuf = (char*)malloc(L4Y_JSON_MAX);
      queue = xQueueCreate(8, sizeof(L4yBleMsg));
      if (!queue || !cmdBuf) return;
      startBle();
      // started by "switch Bluetooth on" (restart): stay on 5 minutes so the app has time to connect
      if (l4yBleGraceMagic == L4Y_BLE_GRACE_MAGIC) { l4yBleGraceMagic = 0; bleGraceUntil = millis() + 5UL * 60 * 1000; }
    }

    void loop() override {
      // new LED settings are already in cfg.json (saveLedCfg): restart so WLED starts with them
      if (rebootAfterSave) { rebootAfterSave = false; configNeedsWrite = false; doReboot = true; }   // cfg.json already written
      if (rebootWhenSaved && !doInitBusses && !configNeedsWrite) { rebootWhenSaved = false; doReboot = true; }
      // Bluetooth switched on / off from the Wi-Fi page or the app ({"l4y":{"ble":..}}), applied here (not in the JSON handler)
      if (bleWanted == 1) { bleWanted = -1; if (!running && enabled) { l4yBleGraceMagic = L4Y_BLE_GRACE_MAGIC; doReboot = true; } }   // restart with Bluetooth on (see l4yBleGraceMagic)
      else if (bleWanted == 0) { bleWanted = -1; if (running) { stopBle(); return; } }
      if (!running) return;
      L4yBleMsg m;
      while (xQueueReceive(queue, &m, 0) == pdTRUE) {
        if (m.kind == 1)      handleImprov(m.data, m.len);
        else if (m.kind == 2) handleJsonCmd(m.data, m.len);
        else                  handleFile(m.data, m.len);
        free(m.data);
        if (rebootAfterSave) break;   // settings saved: restart before anything else can change (and re-save) them
      }
      if (improvState == ST_PROVISIONING) {
        if (WLED_CONNECTED) {
          String url = String(F("http://")) + Network.localIP().toString();
          const char* s[1] = { url.c_str() };
          sendImprovResult(0x01, s, 1);
          setImprovState(ST_PROVISIONED);
        } else if (millis() - provStart > 30000) {
          setImprovError(0x03); // unable to connect
          setImprovState(ST_AUTHORIZED);
        }
      }
      // only build the state JSON while an app is connected: avoids heap churn (fragmentation) when nobody listens
      const bool hasClient = server && server->getConnectedCount();
      if (hasClient && !hadClient) { lastStateJson = ""; lastStateCheck = 0; }   // fresh connection: send the current state now
      hadClient = hasClient;
      // "stay on with Wi-Fi" off: release Bluetooth only once Wi-Fi is up AND no app has been connected for a while,
      // so an open Bluetooth session (or the switch from Bluetooth to Wi-Fi in the app) is never cut off
      if (hasClient || keepOnWifi || !WLED_CONNECTED || improvState == ST_PROVISIONING || (int32_t)(bleGraceUntil - millis()) > 0) idleSince = millis();
      else if (millis() - idleSince > L4Y_BLE_IDLE_OFF) { stopBle(); return; }
      if (hasClient) sendPeek();
      if (hasClient && millis() - lastStateCheck > 500) {
        lastStateCheck = millis();
        // the list (GIF names, presets, diagnostics) changes rarely: rebuild it every 1.5 s, or straight away after a file change
        if (listDirty || millis() - lastListBuild > 1500) { lastListBuild = millis(); updateList(); }
        String s = buildState();
        if (s != lastStateJson) {
          lastStateJson = s;
          ctlState->setValue((const uint8_t*)s.c_str(), s.length());
          ctlState->notify();
        }
      }
    }

    void connected() override {
      if (running && improvState != ST_PROVISIONING && improvState != ST_PROVISIONED) setImprovState(ST_PROVISIONED);
    }

    // shut Bluetooth down and give its memory (stack + controller) back to the LEDs; needs a reboot to come back
    void stopBle() {
      running = false;
      NimBLEDevice::deinit(true);
      l4yBleActive = false;
      WiFi.setSleep(!noWifiSleep);   // Bluetooth gone: no more modem sleep (unless chosen), steadier LED data on the C3
      server = nullptr; impState = impError = impRes = ctlState = ctlFile = ctlList = ctlPeek = nullptr;
      if (cmdBuf) { free(cmdBuf); cmdBuf = nullptr; }
      L4yBleMsg m;
      while (queue && xQueueReceive(queue, &m, 0) == pdTRUE) free(m.data);
      DEBUG_PRINTLN(F("LED4YOU BLE stopped to free RAM"));
    }

    void onUpdateBegin(bool init) override {
      // free radio time and RAM for the OTA upload
      if (!running) return;
      if (init) NimBLEDevice::getAdvertising()->stop();
      else      NimBLEDevice::getAdvertising()->start();
    }

    // {"l4y":{"rl":1}} reloads the My LEDs table (sent by the Studio page after an upload over Wi-Fi)
    void readFromJsonState(JsonObject& root) override {
      JsonObject l = root[F("l4y")];
      if (!l.isNull() && (l[F("rl")] | 0)) myLedsVersion++;
      if (!l.isNull() && l[F("ble")].is<int>()) bleWanted = l[F("ble")].as<int>() ? 1 : 0;
    }
    // lets the Studio page find the My LEDs effect number
    void addToJsonState(JsonObject& root) override {
      JsonObject l = root[F("l4y")];
      if (l.isNull()) l = root.createNestedObject(F("l4y"));
      l[F("mfx")] = myLedsFxId;
      l[F("ble")] = running ? 1 : 0;   // Bluetooth on right now (it switches itself off with Wi-Fi up and no app)
    }

    void addToJsonInfo(JsonObject& root) override {
      JsonObject user = root["u"];
      if (user.isNull()) user = root.createNestedObject("u");
      JsonArray a = user.createNestedArray(F("Bluetooth"));
      // a button in the Info panel switches Bluetooth on (it uses ~50 KB of RAM) or off again, without a restart
      if (!enabled) { a.add(F("off")); return; }
      String b = F("<button class=\"btn btn-xs\" onclick=\"requestJson({l4y:{ble:");
      b += running ? '0' : '1';
      b += F("}});\">");
      b += running ? F("on &#x2022; switch off") : F("off &#x2022; switch on (restarts the lights)");
      b += F("</button>");
      a.add(b);
    }

    void addToConfig(JsonObject& root) override {
      JsonObject top = root.createNestedObject(FPSTR(_name));
      top[FPSTR(_enabled)] = enabled;
      top[FPSTR(_keepOn)] = keepOnWifi;
    }

    bool readFromConfig(JsonObject& root) override {
      JsonObject top = root[FPSTR(_name)];
      bool complete = getJsonValue(top[FPSTR(_enabled)], enabled, true);
      complete &= getJsonValue(top[FPSTR(_keepOn)], keepOnWifi, false);
      return complete;
    }
};

const char Led4youBle::_name[]    PROGMEM = "LED4YOU Bluetooth";
const char Led4youBle::_enabled[] PROGMEM = "enabled";
const char Led4youBle::_keepOn[]  PROGMEM = "stay on with Wi-Fi";   // renamed in v10 so the new default (off) applies

static Led4youBle led4youBle;
REGISTER_USERMOD(led4youBle);
// AI: end

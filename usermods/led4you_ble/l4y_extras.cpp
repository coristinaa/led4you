/*
 * LED4YOU Extras usermod
 *  - seasonal effects: Candy Cane, Snowfall, Haunted, Retro Tree
 *  - schedule: switch on at a time or at sunset (optionally with a preset), switch off at a time or at sunrise
 *  - time and location from the app ({"time":unix} is WLED's own API, {"l4y":{"tz":sec,"geo":[lat,lon]}})
 *  - countdown shown by the Scrolling Text effect ({"l4y":{"cd":{"on":1,"t":localUnix,"n":"XMAS"}}})
 *  - motion sensor (PIR) that plays a preset for a few seconds, then restores what was showing
 *  - group sync switches (WLED UDP notifications) and playlist stop
 *  - house scenes: one command plays preset N on every LED4YOU in the house (UDP broadcast, each board its own preset N)
 * Everything is set through the JSON state API under "l4y", so the app (Bluetooth) and the
 * Studio page (Wi-Fi) use the same commands. Status is reported in /json/state "l4y" and over Bluetooth.
 */
#include "wled.h"
#include <WiFiUdp.h>

#define L4Y_FW_VERSION 69      // LED4YOU firmware version, compared with firmware/latest.json on the LED4YOU site
#define L4Y_HOUSE_PORT 21329   // UDP port for house scenes ("L4YS" packets)
extern const int l4yFwVersion = L4Y_FW_VERSION;   // shown by Improv (installer, Wi-Fi setup) as "v.."

// AI: below section was generated by an AI

// ---------------- seasonal effects ----------------
static uint8_t l4yFxIds[4] = { 255, 255, 255, 255 };   // Candy Cane, Snowfall, Haunted, Retro Tree

static inline uint32_t xhash(uint32_t x) {
  x ^= x >> 16; x *= 0x7feb352dU; x ^= x >> 15; x *= 0x846ca68bU; x ^= x >> 16;
  return x;
}

// Candy Cane: moving stripes of colour 1 and colour 2 (white if colour 2 is black) with soft edges.
// speed = movement, intensity = stripe width
static void mode_candycane(void) {
  const uint32_t a = SEGCOLOR(0) ? SEGCOLOR(0) : RED;
  const uint32_t b = SEGCOLOR(1) ? SEGCOLOR(1) : WHITE;
  const unsigned width = 2 + (SEGMENT.intensity >> 4);          // 2..17 LEDs per stripe
  const unsigned period = width * 2 * 256;                      // one red+white cycle in 1/256 LED units
  const uint32_t shift = (strip.now * (SEGMENT.speed + 1)) >> 6; // 1/256 LED units
  for (unsigned i = 0; i < SEGLEN; i++) {
    const unsigned p = (i * 256 + shift) % period;
    const unsigned half = width * 256;
    // distance into the stripe decides a short soft fade at both edges
    const unsigned inStripe = p % half;
    uint8_t edge = 255;
    if (inStripe < 128) edge = 128 + inStripe;
    else if (half - inStripe < 128) edge = 128 + (half - inStripe);
    const uint32_t main = p < half ? a : b, other = p < half ? b : a;
    SEGMENT.setPixelColor(i, color_blend(other, main, edge));
  }
}
static const char _data_FX_L4Y_CANDYCANE[] PROGMEM = "Candy Cane@!,Stripe width;Stripe,Gap;;01;sx=64,ix=48";

// Snowfall: flakes fall down the strip (towards LED 1) or down a matrix, over a dim background (colour 2).
// speed = fall speed, intensity = amount of snow
static void mode_snowfall(void) {
  const bool is2D = SEGMENT.is2D();
  const unsigned w = is2D ? SEG_W : 1, hgt = is2D ? SEG_H : SEGLEN;
  const unsigned n = w * hgt;
  if (!SEGENV.allocateData(n)) { SEGMENT.fill(SEGCOLOR(1)); return; }
  uint8_t* f = SEGENV.data;   // flake brightness per pixel
  if (SEGENV.call == 0) memset(f, 0, n);
  const uint32_t step = 20 + ((255 - SEGMENT.speed) * 3);   // ms per row: 20..785
  if (strip.now - SEGENV.step >= step) {
    SEGENV.step = strip.now;
    // move every column one row down: row 0 is the top on a matrix, the last LED is the top on a strip
    for (unsigned x = 0; x < w; x++) {
      if (is2D) {
        for (int y = hgt - 1; y > 0; y--) f[y * w + x] = f[(y - 1) * w + x];
        f[x] = (hw_random8() < (SEGMENT.intensity >> 2) + 4) ? 160 + hw_random8(96) : 0;
      } else {
        for (unsigned y = 0; y + 1 < hgt; y++) f[y] = f[y + 1];
        f[hgt - 1] = (hw_random8() < (SEGMENT.intensity >> 1) + 8) ? 160 + hw_random8(96) : 0;
      }
    }
  }
  const uint32_t bg = SEGCOLOR(1), fg = SEGCOLOR(0) ? SEGCOLOR(0) : WHITE;
  for (unsigned i = 0; i < n; i++) {
    const uint32_t c = color_blend(bg, fg, f[i]);
    if (is2D) SEGMENT.setPixelColorXY(i % w, i / w, c);
    else SEGMENT.setPixelColor(i, c);
  }
}
static const char _data_FX_L4Y_SNOWFALL[] PROGMEM = "Snowfall@Fall speed,Amount of snow;Snow,Sky;;12;sx=128,ix=96";

// Haunted: a failing light bulb. Mostly steady, random flicker bursts and short blackouts.
// speed = how fast it flickers during a burst, intensity = how often bursts happen
static void mode_haunted(void) {
  // SEGENV.aux0: remaining burst frames, SEGENV.aux1: current level, SEGENV.step: time of next change
  const uint32_t c = SEGCOLOR(0) ? SEGCOLOR(0) : 0xFF6A10;
  if (strip.now >= SEGENV.step) {
    if (SEGENV.aux0 > 0) {   // inside a burst: jump between dark and bright
      SEGENV.aux0--;
      SEGENV.aux1 = hw_random8() < 90 ? hw_random8(8) : 120 + hw_random8(136);
      SEGENV.step = strip.now + 20 + hw_random8(40) + ((255 - SEGMENT.speed) >> 1);
    } else if (hw_random8() < (SEGMENT.intensity >> 3) + 2) {   // start a new burst
      SEGENV.aux0 = 3 + hw_random8(12);
      SEGENV.step = strip.now;
    } else {                 // steady glow with a slight hum
      SEGENV.aux1 = 200 + hw_random8(56);
      SEGENV.step = strip.now + 80 + hw_random8(120);
    }
  }
  for (unsigned i = 0; i < SEGLEN; i++) {
    // small per-LED variation so long strips do not look perfectly flat
    const uint8_t v = qadd8(SEGENV.aux1 > 16 ? SEGENV.aux1 - 16 : 0, xhash(i * 31 + (strip.now >> 7)) & 31);
    SEGMENT.setPixelColor(i, color_fade(c, v));
  }
}
static const char _data_FX_L4Y_HAUNTED[] PROGMEM = "Haunted@Flicker speed,Scare rate;Bulb;;01;sx=160,ix=96";

// Retro Tree: classic big-bulb Christmas lights (red, green, blue, orange, pink) that slowly glow up and down.
// speed = glow speed, intensity = how deep the bulbs dim
static void mode_retrotree(void) {
  static const uint32_t bulbs[5] = { 0xFF0A00, 0x00C814, 0x0030FF, 0xFF7800, 0xFF2878 };
  const uint32_t period = 1000 + (255 - SEGMENT.speed) * 24;   // 1..7 s per glow
  const uint8_t depth = SEGMENT.intensity;
  for (unsigned i = 0; i < SEGLEN; i++) {
    const uint32_t ph = xhash(i * 2654435761U) % period;       // every bulb has its own phase
    const uint8_t pos = ((strip.now + ph) % period) * 256 / period;
    const uint8_t s = sin8_t(pos);
    const uint8_t lvl = 255 - scale8(255 - s, depth);
    SEGMENT.setPixelColor(i, color_fade(bulbs[i % 5], lvl));
  }
}
static const char _data_FX_L4Y_RETROTREE[] PROGMEM = "Retro Tree@Glow speed,Glow depth;;;01;sx=96,ix=128";

#ifdef WLED_ENABLE_DMX_INPUT
bool l4yDmxInOn = true;      // read by wled.cpp: DMX input starts at boot only when on (pins are in Sync Interfaces)
#endif
#ifdef WLED_ENABLE_DMX
extern bool l4yDmxOutOn;     // dmx_output.cpp: DMX output on/off and its data pin (applied at boot)
extern int8_t l4yDmxOutPin;
extern uint16_t l4yDmxOutFixtures;
#endif

// ---------------- status for the Bluetooth usermod ----------------
class Led4youExtras;
static Led4youExtras* l4yExtras = nullptr;
void l4yExtrasStatus(JsonObject o);

class Led4youExtras : public Usermod {
  private:
    static const char _name[];

    // schedule: mode 0 off, 1 fixed time (t = minute of day), 2 sunset/sunrise (t = offset in minutes)
    uint8_t onMode = 0, offMode = 0, onPreset = 0, days = 0x7F;   // days: bit 0 = Sunday
    int16_t onTime = 0, offTime = 0;
    int lastMinute = -1, lastDay = -1;

    // countdown
    bool cdOn = false;
    uint32_t cdTarget = 0;      // local time (seconds)
    char cdName[17] = "";
    uint32_t cdLast = 0;

    // motion sensor
    bool pirEn = false, pirNight = false;
    int8_t pirPin = -1;
    uint8_t pirPreset = 0;
    uint16_t pirDur = 15;       // seconds
    bool pirPrev = false, pirActive = false, pirTest = false;
    uint32_t pirUntil = 0;
    String pirRestore;          // state shown before the motion preset

    // house scenes
    bool houseJoin = true;      // react to scenes sent by other LED4YOU lights
    uint8_t houseId = 1;        // only lights with the same house number react (neighbours, test setups)
    bool schHouse = false;      // schedule switches the whole house (sends a scene) instead of only this light
    WiFiUDP houseUdp;
    bool udpUp = false;
    uint8_t txSeq = 0, txScene = 0, txLeft = 0, rxSeq = 0;
    uint32_t txNext = 0, rxTime = 0;

    bool timeValid() const { return toki.getTimeSource() > TOKI_TS_NONE && localTime > 1600000000UL; }
    static int minuteOf(time_t t) { return hour(t) * 60 + minute(t); }

    void setPirPin(int8_t p) {
      if (p == pirPin) return;
      if (pirPin >= 0) PinManager::deallocatePin(pirPin, PinOwner::UM_Unspecified);
      pirPin = -1;
      if (p >= 0 && PinManager::allocatePin(p, false, PinOwner::UM_Unspecified)) { pirPin = p; pinMode(pirPin, INPUT); }
    }

    // scene n: 0 = everything off, 1..250 = play this light's own preset n
    void playScene(uint8_t n) {
      if (n == 0) { lightsOff(); return; }
      applyPreset(n, CALL_MODE_DIRECT_CHANGE);
    }
    // play here and tell the rest of the house; sent 3 times because Wi-Fi broadcasts can get lost
    void sendScene(uint8_t n) {
      playScene(n);
      txScene = n; txSeq++; txLeft = 3; txNext = millis();
    }

    // "Play all" from the GIF pack: the main segment plays every stored GIF whose name starts with gifRotPrefix
    // (hw- Halloween, xm- Christmas, ev- other), a new one every gifRotSec seconds. Stops when another effect is chosen.
    char gifRotPrefix[8] = "";
    uint16_t gifRotSec = 0;
    uint32_t gifRotNext = 0;
    int gifRotSeg = -1;      // segment (zone / panel) that rotates, -1 = main segment
    void runGifRotation() {
      if (!gifRotSec || (long)(millis() - gifRotNext) < 0) return;
      gifRotNext = millis() + gifRotSec * 1000UL;
      if (gifRotSeg >= (int)strip.getSegmentsNum()) { gifRotSec = 0; return; }
      Segment& seg = gifRotSeg >= 0 ? strip.getSegment(gifRotSeg) : strip.getMainSegment();
      if (seg.mode != FX_MODE_IMAGE) { gifRotSec = 0; return; }
      const char* cur = seg.name ? seg.name : "";
      String first, next;
      File root = WLED_FS.open("/");
      File f = root.openNextFile();
      while (f) {
        String n = f.name();
        f.close();
        if (n.startsWith("/")) n = n.substring(1);
        if (n.startsWith(gifRotPrefix) && n.endsWith(".gif")) {
          if (!first.length() || n < first) first = n;                                   // alphabetical order
          if (strcmp(n.c_str(), cur) > 0 && (!next.length() || n < next)) next = n;
        }
        f = root.openNextFile();
      }
      root.close();
      if (!next.length()) next = first;                                                   // back to the start
      if (next.length() && strcmp(next.c_str(), cur) != 0) seg.setName(next);
    }

    void runHouse() {
      if (!WLED_CONNECTED) { udpUp = false; return; }
      if (!udpUp) udpUp = houseUdp.begin(L4Y_HOUSE_PORT);
      if (!udpUp) return;
      if (txLeft && (long)(millis() - txNext) >= 0) {
        const uint8_t pkt[7] = { 'L', '4', 'Y', 'S', houseId, txScene, txSeq };
        const IPAddress bc = WiFi.broadcastIP();   // e.g. 192.168.1.255, from the router's subnet mask
        houseUdp.beginPacket(bc, L4Y_HOUSE_PORT); houseUdp.write(pkt, sizeof(pkt)); houseUdp.endPacket();
        txLeft--; txNext = millis() + 150 + 100 * (3 - txLeft);
      }
      const int len = houseUdp.parsePacket();
      if (len <= 0) return;
      uint8_t pkt[8] = { 0 };
      const int n = houseUdp.read(pkt, sizeof(pkt));
      if (n < 7 || memcmp(pkt, "L4YS", 4) || !houseJoin || pkt[4] != houseId) return;
      if (houseUdp.remoteIP() == Network.localIP()) return;                 // my own broadcast
      if (pkt[6] == rxSeq && millis() - rxTime < 3000) return;               // repeat of the same scene
      rxSeq = pkt[6]; rxTime = millis();
      playScene(pkt[5]);
    }

    void lightsOn(uint8_t preset) {
      if (schHouse && preset) { sendScene(preset); return; }
      if (preset) { applyPreset(preset, CALL_MODE_DIRECT_CHANGE); return; }
      if (!bri) { bri = briLast ? briLast : 128; stateUpdated(CALL_MODE_DIRECT_CHANGE); }
    }
    void lightsOff() {
      if (bri) { briLast = bri; bri = 0; stateUpdated(CALL_MODE_DIRECT_CHANGE); }
    }

    // minute of day for an event, or -1 if it cannot be computed (no time or no sunset/sunrise)
    int eventMinute(uint8_t mode, int16_t t, bool sun) const {
      if (mode == 1) return t;
      if (mode == 2) {
        const time_t s = sun ? sunset : sunrise;
        if (!s) return -1;
        return ((minuteOf(s) + t) % 1440 + 1440) % 1440;
      }
      return -1;
    }

    void runSchedule() {
      if (!timeValid()) return;
      const int d = day(localTime);
      if (d != lastDay) { lastDay = d; calculateSunriseAndSunset(); }   // sunset moves a little every day
      const int m = minuteOf(localTime);
      if (m == lastMinute) return;
      lastMinute = m;
      if (!(days & (1 << (weekday(localTime) - 1)))) return;
      if (m == eventMinute(onMode, onTime, true))   lightsOn(onPreset);
      if (m == eventMinute(offMode, offTime, false)) { if (schHouse) sendScene(0); else lightsOff(); }
    }

    void runCountdown() {
      if (!cdOn || !timeValid() || millis() - cdLast < 1000) return;
      cdLast = millis();
      Segment& seg = strip.getMainSegment();
      if (seg.mode != FX_MODE_2DSCROLLTEXT) return;
      char txt[40];
      const long left = (long)cdTarget - (long)localTime;
      if (left <= 0) snprintf_P(txt, sizeof(txt), PSTR("%s!"), cdName);
      else if (left >= 86400) snprintf_P(txt, sizeof(txt), PSTR("%s %ldd %ldh"), cdName, left / 86400, (left % 86400) / 3600);
      else snprintf_P(txt, sizeof(txt), PSTR("%s %02ld:%02ld:%02ld"), cdName, left / 3600, (left % 3600) / 60, left % 60);
      if (!seg.name || strcmp(seg.name, txt)) seg.setName(txt);
    }

    bool isNight() const {
      if (!timeValid() || !sunset || !sunrise) return true;   // unknown: always allow
      const int m = minuteOf(localTime);
      return m >= minuteOf(sunset) || m < minuteOf(sunrise);
    }

    void startScare() {
      if (!pirActive) {
        // remember what is showing now so it can come back afterwards
        if (requestJSONBufferLock(JSON_LOCK_REMOTE)) {
          pDoc->clear();
          JsonObject s = pDoc->to<JsonObject>();
          serializeState(s, true, true, false);
          pirRestore = "";
          serializeJson(*pDoc, pirRestore);
          releaseJSONBufferLock();
        }
        if (pirPreset) applyPreset(pirPreset, CALL_MODE_DIRECT_CHANGE);
      }
      pirActive = true;
      pirUntil = millis() + pirDur * 1000UL;   // more movement keeps it going
    }

    void endScare() {
      pirActive = false;
      if (pirRestore.length() && requestJSONBufferLock(JSON_LOCK_REMOTE)) {
        if (!deserializeJson(*pDoc, pirRestore)) deserializeState(pDoc->as<JsonObject>(), CALL_MODE_DIRECT_CHANGE);
        releaseJSONBufferLock();
      }
      pirRestore = "";
    }

    void runPir() {
      if (pirTest) { pirTest = false; startScare(); }
      if (pirEn && pirPin >= 0) {
        const bool v = digitalRead(pirPin);
        if (v && !pirPrev && (!pirNight || isNight())) startScare();
        else if (v && pirActive) pirUntil = millis() + pirDur * 1000UL;
        pirPrev = v;
      }
      if (pirActive && (long)(millis() - pirUntil) >= 0) endScare();
    }

    // ---------- zones kept over a restart ----------
    // AI: below section was generated by an AI
    // WLED keeps segments only in RAM (or in a boot preset), so the zones made in the app were gone after a restart
    // and the app's zone buttons then pointed at zones that no longer existed. The zone layout (not the effects) is
    // saved to /l4yzones.json a few seconds after it changes and put back at start-up, as long as the LED outputs are
    // the same as when it was saved (a new LED setup makes its own zones) and no boot preset is set.
    bool     zonesRestored = false;    // start-up check done: saving is allowed from now on
    uint32_t zonesSig = 0, zonesSavedSig = 0, zonesChangedAt = 0, zonesCheckAt = 0;

    static uint32_t zHash(uint32_t h, uint32_t v) { return (h ^ v) * 16777619u; }
    uint32_t busSig() const {
      uint32_t h = zHash(2166136261u, strip.getLengthTotal());
      h = zHash(h, Segment::maxWidth); h = zHash(h, Segment::maxHeight);
      for (size_t i = 0; i < BusManager::getNumBusses(); i++) {
        const Bus* b = BusManager::getBus(i); if (!b) break;
        h = zHash(h, b->getStart()); h = zHash(h, b->getLength());
      }
      return h;
    }
    static uint8_t zOpts(const Segment& g) { return (g.reverse ? 1 : 0) | (g.mirror ? 2 : 0) | (g.reverse_y ? 4 : 0) | (g.mirror_y ? 8 : 0); }
    uint32_t zoneSig() const {
      uint32_t h = busSig();
      for (size_t i = 0; i < strip.getSegmentsNum(); i++) {
        const Segment& g = strip.getSegment(i);
        if (g.stop <= g.start) continue;
        h = zHash(h, i); h = zHash(h, g.start); h = zHash(h, g.stop); h = zHash(h, g.startY); h = zHash(h, g.stopY);
        h = zHash(h, zOpts(g)); h = zHash(h, g.grouping); h = zHash(h, g.spacing); h = zHash(h, g.offset);
      }
      return h;
    }
    void saveZones() {
      if (!requestJSONBufferLock(JSON_LOCK_REMOTE)) return;
      pDoc->clear();
      JsonObject o = pDoc->to<JsonObject>();
      o["b"] = busSig();
      JsonArray z = o.createNestedArray("z");
      for (size_t i = 0; i < strip.getSegmentsNum(); i++) {
        const Segment& g = strip.getSegment(i);
        if (g.stop <= g.start) continue;
        JsonArray a = z.createNestedArray();
        a.add(i); a.add(g.start); a.add(g.stop); a.add(g.startY); a.add(g.stopY); a.add(zOpts(g)); a.add(g.grouping); a.add(g.spacing); a.add(g.offset);
      }
      File f = WLED_FS.open(F("/l4yzones.json"), "w");
      if (f) { serializeJson(*pDoc, f); f.close(); }
      releaseJSONBufferLock();
    }
    void restoreZones() {
      if (bootPreset > 0 || !WLED_FS.exists(F("/l4yzones.json"))) return;
      if (!requestJSONBufferLock(JSON_LOCK_REMOTE)) return;
      File f = WLED_FS.open(F("/l4yzones.json"), "r");
      bool ok = f && !deserializeJson(*pDoc, f);
      if (f) f.close();
      if (ok && (*pDoc)["b"].as<uint32_t>() == busSig() && (*pDoc)["z"].size() > 1) {
        // turn the saved list into a normal "seg" command (zones that are there now but not in the file are removed)
        JsonArray saved = (*pDoc)["z"];
        DynamicJsonDocument cmd(256 + saved.size() * 160);
        JsonArray segs = cmd.createNestedArray("seg");
        uint32_t used = 0;
        for (JsonArray a : saved) {
          const unsigned id = a[0];
          if (id >= WS2812FX::getMaxSegments()) continue;
          JsonObject s = segs.createNestedObject();
          const uint8_t op = a[5];
          s["id"] = id; s["start"] = a[1]; s["stop"] = a[2]; s["startY"] = a[3]; s["stopY"] = a[4];
          s["rev"] = (bool)(op & 1); s["mi"] = (bool)(op & 2); s["rY"] = (bool)(op & 4); s["mY"] = (bool)(op & 8);
          s["grp"] = a[6]; s["spc"] = a[7]; s["of"] = a[8]; s["on"] = true;
          used |= 1u << id;
        }
        for (size_t i = 0; i < strip.getSegmentsNum() && i < 32; i++) if (!(used & (1u << i))) { JsonObject s = segs.createNestedObject(); s["id"] = i; s["stop"] = 0; }
        releaseJSONBufferLock();
        if (requestJSONBufferLock(JSON_LOCK_REMOTE)) {
          pDoc->clear();
          pDoc->set(cmd);
          deserializeState(pDoc->as<JsonObject>(), CALL_MODE_INIT);
          releaseJSONBufferLock();
        }
        return;
      }
      releaseJSONBufferLock();
    }
    void runZoneMemory() {
      const uint32_t now = millis();
      if ((int32_t)(now - zonesCheckAt) < 0) return;
      zonesCheckAt = now + 2000;
      if (!zonesRestored) {
        if (now < 3000 || strip.isUpdating()) return;   // let the LED outputs and the boot finish first
        restoreZones();
        zonesRestored = true;
        zonesSavedSig = zonesSig = zoneSig();
        return;
      }
      if (errorFlag == ERR_NORAM || errorFlag == ERR_NORAM_PX) return;   // memory trouble may have removed zones: keep the saved ones
      const uint32_t sg = zoneSig();
      if (sg != zonesSig) { zonesSig = sg; zonesChangedAt = now; return; }
      if (sg != zonesSavedSig && now - zonesChangedAt > 5000) { saveZones(); zonesSavedSig = sg; }
    }
    // AI: end

  public:
    void setup() override {
      l4yExtras = this;
      l4yFxIds[0] = strip.addEffect(255, &mode_candycane, _data_FX_L4Y_CANDYCANE);
      l4yFxIds[1] = strip.addEffect(255, &mode_snowfall,  _data_FX_L4Y_SNOWFALL);
      l4yFxIds[2] = strip.addEffect(255, &mode_haunted,   _data_FX_L4Y_HAUNTED);
      l4yFxIds[3] = strip.addEffect(255, &mode_retrotree, _data_FX_L4Y_RETROTREE);
      int8_t p = pirPin; pirPin = -1; setPirPin(p);
    }

    void loop() override {
      runSchedule();
      runCountdown();
      runPir();
      runHouse();
      runGifRotation();
      runZoneMemory();
    }

    // commands under "l4y" in the JSON state API (Wi-Fi /json/state and Bluetooth)
    void readFromJsonState(JsonObject& root) override {
      // drawing on the lights freezes the segment: choosing an effect afterwards should animate again
      JsonVariant sv = root["seg"];
      JsonObject so = sv.is<JsonArray>() ? sv[0].as<JsonObject>() : sv.as<JsonObject>();
      if (!so.isNull() && so.containsKey("fx") && !so.containsKey("i") && !so.containsKey(F("frz"))) {
        Segment& seg = so.containsKey("id") ? strip.getSegment(so["id"] | 0) : strip.getMainSegment();
        seg.freeze = false;
      }
      // text running up/down turns the matrix on its side: turn it back when another effect is chosen
      static bool textSideways = false;
      JsonVariant txv = root[F("l4y")][F("txv")];
      if (!txv.isNull()) {
        textSideways = txv.as<bool>();
        // new text or new direction from the app: start the message from the edge now, instead of carrying on from
        // where the old text was (that looked like a delay before left/right text started)
        if (!so.isNull() && (so["fx"] | -1) == FX_MODE_2DSCROLLTEXT) {
          static uint32_t lastTxt = 0;
          Segment& seg = so.containsKey("id") ? strip.getSegment(so["id"] | 0) : strip.getMainSegment();
          const char* n = seg.name ? seg.name : "";
          uint32_t h = 2166136261u;
          for (const char* c = n; *c; c++) h = (h ^ (uint8_t)*c) * 16777619u;
          h = (h ^ (seg.check3 ? 1u : 0u)) * 16777619u;   // Reverse = right / down
          h = (h ^ (seg.transpose ? 2u : 0u)) * 16777619u;
          if (h != lastTxt) { lastTxt = h; seg.markForReset(); }
        }
      }
      else if (textSideways && !so.isNull() && so.containsKey("fx") && !so.containsKey(F("tp")) && (so["fx"] | 0) != FX_MODE_2DSCROLLTEXT) {
        Segment& seg = so.containsKey("id") ? strip.getSegment(so["id"] | 0) : strip.getMainSegment();
        seg.transpose = false; seg.markForReset(); textSideways = false;
      }

      JsonObject l = root[F("l4y")];
      // GIF rotation: started with {"l4y":{"gr":{"p":"hw-","s":10}}}, any other effect choice stops it
      if (!l.isNull() && l[F("gr")].is<JsonObject>()) {
        JsonObject gr = l[F("gr")];
        strlcpy(gifRotPrefix, gr["p"] | "", sizeof(gifRotPrefix));
        gifRotSec = gifRotPrefix[0] ? constrain((int)(gr["s"] | 10), 3, 600) : 0;
        gifRotNext = millis() + gifRotSec * 1000UL;
        gifRotSeg = gr["id"] | -1;
      } else if (gifRotSec && !so.isNull() && so.containsKey("fx") && (gifRotSeg < 0 || (so["id"] | -1) == gifRotSeg || !so.containsKey("id"))) gifRotSec = 0;
      if (l.isNull()) return;
      bool save = false;

      if (l[F("tz")].is<int>() && currentTimezone == 0) {   // only when no named time zone is configured (0 = UTC in ntp.cpp)
        const int tz = l[F("tz")];
        if (tz != utcOffsetSecs && tz > -14 * 3600 && tz < 15 * 3600) { utcOffsetSecs = tz; save = true; }
      }
      JsonArray geo = l[F("geo")];
      if (geo.size() == 2) {
        const float la = geo[0], lo = geo[1];
        if (fabsf(la - latitude) > 0.01f || fabsf(lo - longitude) > 0.01f) { latitude = la; longitude = lo; save = true; }
      }
      if (l.containsKey(F("tz")) || geo.size() == 2) { updateLocalTime(); calculateSunriseAndSunset(); lastMinute = minuteOf(localTime); }

      JsonObject sch = l[F("sch")];
      if (!sch.isNull()) {
        onMode   = constrain((int)(sch[F("om")] | onMode), 0, 2);
        onTime   = sch[F("ot")] | onTime;
        onPreset = sch[F("ops")] | onPreset;
        offMode  = constrain((int)(sch[F("fm")] | offMode), 0, 2);
        offTime  = sch[F("ft")] | offTime;
        days     = sch[F("d")] | days;
        schHouse = sch["h"] | schHouse;
        lastMinute = timeValid() ? minuteOf(localTime) : -1;   // do not fire for the minute being edited
        save = true;
      }

      // preset applied when the lights start (WLED's "Apply preset at boot"), set from the app's Setup: {"l4y":{"bp":3}}, 0 = none
      if (l[F("bp")].is<int>()) {
        const int bp = l[F("bp")];
        if (bp >= 0 && bp <= 250 && bp != bootPreset) { bootPreset = bp; save = true; }
      }

      JsonObject cd = l[F("cd")];
      if (!cd.isNull()) {
        cdOn = cd[F("on")] | cdOn;
        cdTarget = cd["t"] | cdTarget;
        if (cd["n"].is<const char*>()) strlcpy(cdName, cd["n"].as<const char*>(), sizeof(cdName));
        cdLast = 0;
        save = true;
      }

      JsonObject pir = l[F("pir")];
      if (!pir.isNull()) {
        pirEn     = pir[F("en")] | pirEn;
        pirNight  = pir[F("nt")] | pirNight;
        pirPreset = pir[F("ps")] | pirPreset;
        pirDur    = constrain((int)(pir[F("dur")] | pirDur), 1, 600);
        if (pir.containsKey(F("pin"))) setPirPin(pir[F("pin")] | -1);
        save = true;
      }
      if (l[F("pirt")] | false) pirTest = true;   // "Test" button: play the motion preset once

      JsonObject sync = l[F("sync")];
      if (!sync.isNull()) {
        sendNotifications = sendNotificationsRT = sync["s"] | sendNotifications;
        if (sync["r"].is<bool>()) receiveGroups = sync["r"].as<bool>() ? 0x01 : 0x00;
        save = true;
      }
      if (l[F("plstop")] | false) unloadPlaylist();

      // house: {"scene":n} plays preset n everywhere (0 = all off); {"hs":{"j":true,"id":1}} membership
      if (l[F("scene")].is<int>()) sendScene(constrain(l[F("scene")].as<int>(), 0, 250));
      JsonObject hs = l[F("hs")];
      if (!hs.isNull()) { houseJoin = hs["j"] | houseJoin; houseId = constrain((int)(hs[F("id")] | houseId), 1, 9); save = true; }
      if (l[F("rt")].is<bool>()) { receiveDirect = l[F("rt")]; save = true; }   // allow xLights / DDP / E1.31 control

      if (save) configNeedsWrite = true;
    }

    void status(JsonObject o) {
      o[F("fw")] = L4Y_FW_VERSION;
      JsonArray fx = o.createNestedArray(F("xfx"));
      for (uint8_t id : l4yFxIds) fx.add(id);
      const bool tv = timeValid();
      o[F("tv")] = tv;
      o[F("now")] = tv ? minuteOf(localTime) : -1;
      o[F("ss")] = tv && sunset ? minuteOf(sunset) : -1;
      o[F("sr")] = tv && sunrise ? minuteOf(sunrise) : -1;
      o[F("geo")] = (int)(latitude * 10) || (int)(longitude * 10);
      JsonObject s = o.createNestedObject(F("sch"));
      s[F("om")] = onMode; s[F("ot")] = onTime; s[F("ops")] = onPreset;
      s[F("fm")] = offMode; s[F("ft")] = offTime; s[F("d")] = days; s["h"] = schHouse;
      JsonObject hs = o.createNestedObject(F("hs"));
      hs["j"] = houseJoin; hs[F("id")] = houseId;
      o[F("rt")] = receiveDirect;
      o[F("live")] = realtimeMode != REALTIME_MODE_INACTIVE;
      JsonObject c = o.createNestedObject(F("cd"));
      c[F("on")] = cdOn; c["t"] = cdTarget; c["n"] = cdName;
      JsonObject p = o.createNestedObject(F("pir"));
      p[F("en")] = pirEn; p[F("pin")] = pirPin; p[F("ps")] = pirPreset; p[F("dur")] = pirDur; p[F("nt")] = pirNight; p["a"] = pirActive;
      JsonObject y = o.createNestedObject(F("sync"));
      y["s"] = sendNotifications; y["r"] = receiveGroups != 0;
      o[F("pwr")] = BusManager::currentMilliamps();
      o[F("ma")] = BusManager::ablMilliampsMax();
      o[F("nl")] = nightlightActive ? (int)(nightlightDelayMs - (millis() - nightlightStartTime)) / 1000 : -1;
      o[F("pl")] = currentPlaylist;
      o[F("bp")] = bootPreset;
    }

    void addToJsonState(JsonObject& root) override {
      JsonObject l = root[F("l4y")];
      if (l.isNull()) l = root.createNestedObject(F("l4y"));
      status(l);
      extern int l4yGifSlotCount();
      l[F("gs")] = l4yGifSlotCount();   // how many GIFs can play at the same time on this board
#ifndef WLED_DISABLE_2D
      // matrix panels [x, y, width, height, options] for the Studio's zones (panels of different sizes)
      if (strip.isMatrix && strip.panel.size() > 1) {
        JsonArray pa = l.createNestedArray(F("pn"));
        for (const auto& pn : strip.panel) { JsonArray q = pa.createNestedArray(); q.add(pn.xOffset); q.add(pn.yOffset); q.add(pn.width); q.add(pn.height); q.add(pn.options); }
      }
#endif
    }

    void addToConfig(JsonObject& root) override {
      JsonObject top = root.createNestedObject(FPSTR(_name));
      top[F("on-mode")] = onMode; top[F("on-time")] = onTime; top[F("on-preset")] = onPreset;
      top[F("off-mode")] = offMode; top[F("off-time")] = offTime; top[F("days")] = days;
      top[F("cd-on")] = cdOn; top[F("cd-target")] = cdTarget; top[F("cd-name")] = cdName;
      top[F("pir-enabled")] = pirEn; top[F("pir-pin")] = pirPin; top[F("pir-preset")] = pirPreset;
      top[F("pir-seconds")] = pirDur; top[F("pir-night-only")] = pirNight;
      top[F("house-join")] = houseJoin; top[F("house-id")] = houseId; top[F("schedule-whole-house")] = schHouse;
      #ifdef WLED_ENABLE_DMX
      top[F("DMX output")] = l4yDmxOutOn;
      top[F("DMX output GPIO")] = l4yDmxOutPin;
      top[F("DMX fixtures")] = l4yDmxOutFixtures;
      #endif
      #ifdef WLED_ENABLE_DMX_INPUT
      top[F("DMX input")] = l4yDmxInOn;
      #endif
    }

    void appendConfigData() override {
      #ifdef WLED_ENABLE_DMX_INPUT
      oappend(F("addInfo('LED4YOU Extras:DMX input',1,'<i>(set the DMX pins in Sync Interfaces; restart after changing)</i>');"));
      #endif
      #ifdef WLED_ENABLE_DMX
      oappend(F("addInfo('LED4YOU Extras:DMX output',1,'<i>(sends the LEDs to DMX fixtures; channels in Config &gt; DMX Output; restart after changing)</i>');"));
      oappend(F("addInfo('LED4YOU Extras:DMX output GPIO',1,'<i>(pin to the RS-485 module DI input, -1 = none; must not be the LED pin)</i>');"));
      #endif
    }

    bool readFromConfig(JsonObject& root) override {
      JsonObject top = root[FPSTR(_name)];
      if (top.isNull()) return false;
      onMode = top[F("on-mode")] | onMode; onTime = top[F("on-time")] | onTime; onPreset = top[F("on-preset")] | onPreset;
      offMode = top[F("off-mode")] | offMode; offTime = top[F("off-time")] | offTime; days = top[F("days")] | days;
      cdOn = top[F("cd-on")] | cdOn; cdTarget = top[F("cd-target")] | cdTarget;
      if (top[F("cd-name")].is<const char*>()) strlcpy(cdName, top[F("cd-name")].as<const char*>(), sizeof(cdName));
      pirEn = top[F("pir-enabled")] | pirEn; pirPreset = top[F("pir-preset")] | pirPreset;
      pirDur = top[F("pir-seconds")] | pirDur; pirNight = top[F("pir-night-only")] | pirNight;
      houseJoin = top[F("house-join")] | houseJoin; houseId = top[F("house-id")] | houseId; schHouse = top[F("schedule-whole-house")] | schHouse;
      #ifdef WLED_ENABLE_DMX
      l4yDmxOutOn = top[F("DMX output")] | l4yDmxOutOn;
      l4yDmxOutPin = top[F("DMX output GPIO")] | l4yDmxOutPin;
      l4yDmxOutFixtures = top[F("DMX fixtures")] | l4yDmxOutFixtures;
      #endif
      #ifdef WLED_ENABLE_DMX_INPUT
      l4yDmxInOn = top[F("DMX input")] | l4yDmxInOn;
      #endif
      const int8_t p = top[F("pir-pin")] | pirPin;
      if (l4yExtras) setPirPin(p); else pirPin = p;   // before setup(): pin is allocated in setup()
      return true;
    }
};

const char Led4youExtras::_name[] PROGMEM = "LED4YOU Extras";

void l4yExtrasStatus(JsonObject o) { if (l4yExtras) l4yExtras->status(o); }

static Led4youExtras led4youExtras;
REGISTER_USERMOD(led4youExtras);

// AI: end
